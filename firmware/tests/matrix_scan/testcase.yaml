## firmware/tests/matrix_scan/testcase.yaml
```yaml
# SPDX-License-Identifier: MIT
tests:
  drivers.matrix_scan:
    platform_allow:
      - native_sim/native
    tags:
      - display
      - reva
```

## firmware/tests/motion/testcase.yaml
```yaml
# SPDX-License-Identifier: MIT
tests:
  services.motion:
    tags: [badge, motion]
    platform_allow: [native_sim, native_sim/native/64]
    integration_platforms: [native_sim]
```

## firmware/tests/ntag/testcase.yaml
```yaml
# SPDX-License-Identifier: MIT
tests:
  services.ntag:
    tags: [badge, nfc]
    platform_allow:
      - native_sim
      - native_sim/native/64
    integration_platforms:
      - native_sim
```

## firmware/tests/power/testcase.yaml
```yaml
# SPDX-License-Identifier: MIT
tests:
  services.power:
    tags: [badge, power]
    platform_allow:
      - native_sim
      - native_sim/native/64
    integration_platforms:
      - native_sim
```

## firmware/tests/qr/testcase.yaml
```yaml
# SPDX-License-Identifier: MIT
tests:
  services.qr:
    tags: badge
    platform_allow:
      - native_sim
      - native_sim/native/64
    integration_platforms:
      - native_sim
```

## firmware/tests/settings/testcase.yaml
```yaml
# SPDX-License-Identifier: MIT
tests:
  services.settings:
    tags: badge
    platform_allow:
      - native_sim
      - native_sim/native/64
    integration_platforms:
      - native_sim
```

## firmware/tests/settings_store/testcase.yaml
```yaml
# SPDX-License-Identifier: MIT
tests:
  services.settings_store:
    tags: [badge, settings]
    platform_allow:
      - native_sim
      - native_sim/native/64
    integration_platforms:
      - native_sim
```

## firmware/tests/voice/testcase.yaml
```yaml
# SPDX-License-Identifier: MIT
tests:
  services.voice:
    platform_allow: native_sim
    tags:
      - audio
      - privacy
```
