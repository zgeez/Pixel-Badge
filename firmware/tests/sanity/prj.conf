## CMakeLists.txt
```
# SPDX-License-Identifier: MIT

cmake_minimum_required(VERSION 3.20.0)

find_package(Zephyr REQUIRED HINTS $ENV{ZEPHYR_BASE})
project(sanity LANGUAGES C CXX)

target_sources(app PRIVATE
	src/main.cpp
)

target_compile_options(app PRIVATE -Wextra -Werror)
```

## prj.conf
```kconfig
# SPDX-License-Identifier: MIT

CONFIG_ZTEST=y
CONFIG_CPP=y
CONFIG_STD_CPP17=y
```

## src/main.cpp
```c
/*
 * SPDX-License-Identifier: MIT
 */

#include <zephyr/ztest.h>

static_assert(__cplusplus >= 201703L, "tests must build as C++17 or later");

ZTEST_SUITE(sanity, nullptr, nullptr, nullptr, nullptr, nullptr);

ZTEST(sanity, test_constexpr_lambda)
{
	/* constexpr lambdas are a C++17 feature. */
	constexpr auto square = [](int x) constexpr { return x * x; };

	static_assert(square(4) == 16);
	zassert_equal(square(3), 9);
}
```
