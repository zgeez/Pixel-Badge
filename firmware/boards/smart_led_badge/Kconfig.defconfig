## firmware/src/drivers/hub75/Kconfig
```kconfig
# SPDX-License-Identifier: MIT

config HUB75_DISPLAY
	bool "HUB75 panel on GPIO (bench display)"
	default y
	depends on DT_HAS_SMARTLEDBADGE_HUB75_ENABLED
	depends on DISPLAY
	depends on SOC_SERIES_NRF53
	select GPIO
	select NRFX_GPPI
	help
	  Drives a HUB75 RGB panel from GPIO with a TIMER, DPPI and GPIOTE, as
	  a monochrome Zephyr display. For the nRF5340 DK bench only; the badge
	  uses its own matrix driver.

config HUB75_DISPLAY_INIT_BRIGHTNESS
	int "Brightness at start-up"
	default 128
	range 0 255
	depends on HUB75_DISPLAY
	help
	  On-time fraction of each row slot, 0-255. Lower values also lower
	  the panel supply's average current; the peak per row stays the same.
```

## firmware/src/drivers/icm42688_i2c/Kconfig
```kconfig
# SPDX-License-Identifier: MIT

config ICM42688_I2C
	bool "TDK ICM-42688-P on I2C"
	default y
	depends on DT_HAS_INVENSENSE_ICM42688P_I2C_ENABLED
	depends on SENSOR
	select I2C
	help
	  Project driver for the ICM-42688-P on I2C. Zephyr's icm4268x driver
	  in NCS v3.4.1 supports SPI only; to use SPI instead, move the node to
	  an SPI bus with compatible = "invensense,icm42688",
	  "invensense,icm4268x" (the driver binds to "invensense,icm4268x").

config ICM42688_I2C_TRIGGER
	bool "Data-ready interrupt"
	default y
	depends on ICM42688_I2C
	depends on GPIO
	depends on $(dt_compat_any_has_prop,$(DT_COMPAT_INVENSENSE_ICM42688P_I2C),int-gpios)
	help
	  Deliver SENSOR_TRIG_DATA_READY from INT1 through the system work
	  queue.
```

## firmware/tests/artwork_store/testcase.yaml
```yaml
# SPDX-License-Identifier: MIT
tests:
  services.artwork_store:
    platform_allow: native_sim
    tags:
      - storage
      - artwork
```

## firmware/tests/audio/testcase.yaml
```yaml
# SPDX-License-Identifier: MIT
tests:
  services.audio:
    platform_allow: native_sim
    tags:
      - audio
      - privacy
```

## firmware/tests/audio_crypto/testcase.yaml
```yaml
# SPDX-License-Identifier: MIT
tests:
  services.audio_crypto:
    platform_allow: native_sim
    tags:
      - audio
      - security
```

## firmware/tests/ble_protocol/testcase.yaml
```yaml
# SPDX-License-Identifier: MIT
tests:
  services.ble_protocol:
    tags: [badge, ble]
    platform_allow: [native_sim, native_sim/native/64]
    integration_platforms: [native_sim]
  services.ble_protocol.target_errno:
    tags: [badge, ble]
    platform_allow: [native_sim, native_sim/native/64]
    integration_platforms: [native_sim]
    extra_args: [BADGE_SIMULATE_TARGET_ERRNO=ON]
```

## firmware/tests/content/testcase.yaml
```yaml
# SPDX-License-Identifier: MIT
tests:
  services.content:
    platform_allow:
      - native_sim/native
    tags:
      - studio
      - content
```

## firmware/tests/matrix_chain/testcase.yaml
```yaml
# SPDX-License-Identifier: MIT
tests:
  services.matrix_chain:
    tags: [badge, matrix]
    platform_allow:
      - native_sim
      - native_sim/native/64
    integration_platforms:
      - native_sim
```
