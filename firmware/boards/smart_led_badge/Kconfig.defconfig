## firmware/common/Kconfig
```kconfig
# SPDX-License-Identifier: MIT

menu "Smart LED Badge application"

config BADGE_DISPLAY_SYNC
	bool
	default y if HUB75_DISPLAY || REVA_MATRIX

module = APP
module-str = Application
source "subsys/logging/Kconfig.template.log_config"

config APP_QR_SCREENING
	bool "QR screening instead of the display test patterns"
	depends on DISPLAY
	help
	  Shows the host-generated QR test codes, stepped with Buttons 1 and
	  2, for the scan-reliability screening.

config APP_QR_CODES_FILE
	string "QR screening codes source file"
	depends on APP_QR_SCREENING
	help
	  Generated source with the QR screening codes, instead of the
	  committed representative codes. Used for codes that must stay out
	  of the repository, such as personal links; generate it with
	  scripts/qr/gen_qr_test_codes.py --out-cpp.

config APP_DISPLAY_BRIGHTNESS
	int "Display brightness after the test patterns"
	default 128
	range 1 255

config APP_AUDIO_SCREENING
	bool "Microphone level and spectrum bench"
	depends on DISPLAY && AUDIO_DMIC && !APP_PROTOTYPE && !APP_QR_SCREENING
	help
	  Explicit nRF5340 DK bench image. Captures volatile PCM for the local
	  meter/FFT only; no recording, storage or audio transmission commands.

config APP_AUDIO_CHANNEL
	int "Initial microphone PCM channel (left=0, right=1)"
	depends on APP_AUDIO_SCREENING || APP_AUDIO
	default 0
	range 0 1

config APP_AUDIO
 bool "P3 local visualization and authenticated audio service"
 default y if APP_BLE
	depends on APP_BLE && AUDIO_DMIC && DISPLAY && BADGE_DISPLAY_SYNC && !DEBUG_COREDUMP

config APP_AUDIO_RECORDING_BENCH
 bool "Bench-only recording before REC visibility acceptance"
 depends on APP_AUDIO && !DEBUG_COREDUMP
 help
   Development only. Recording stays disabled in normal/release builds
   pending indoor, outdoor and direct-sun REC visibility acceptance.

config APP_MOTION
	bool "P4 IMU fluid and automatic orientation"
	default y if APP_AUDIO
	depends on APP_AUDIO && SENSOR
	help
	  Bounded particle fluid and gravity orientation on the existing DK IMU.
	  Sensor-to-panel axis mapping remains a bench calibration dependency.

config APP_PROTOTYPE
	bool "Prototype badge application"
	default y if BOARD_NRF5340DK_NRF5340_CPUAPP || BOARD_PIXEL_BADGE_REVA
	depends on DISPLAY && !APP_QR_SCREENING
	select FLASH
	select FLASH_MAP
	select FLASH_PAGE_LAYOUT
	select NVS
	select NVS_DATA_CRC
	select SETTINGS
	select WATCHDOG
	select REBOOT
	select HWINFO

config APP_BRINGUP_CHECKS
	bool "Run optional peripheral bring-up checks"
	default y if !APP_PROTOTYPE
	help
	  Runs outside the normal badge loop. Off in the default prototype.

config APP_POWER_MANAGER
	bool "Rev A charger and battery manager"
	default y if BOARD_PIXEL_BADGE_REVA
	depends on ADC && I2C && GPIO
	help
	  One thread for the BQ25620 and battery sensing (docs/power.md):
	  CC/BC1.2 input-current policy enforced every 20 ms, charger
	  configuration and I2C watchdog, gated charging, VBAT sampling for
	  load shedding and the power-switch reading. The product image and
	  the bring-up diagnostics share it.

config APP_USB_DEVICE
	bool "Rev A USB device for the input-current policy"
	default y if BOARD_PIXEL_BADGE_REVA
	depends on APP_POWER_MANAGER && USB_DEVICE_STACK_NEXT && USBD_CDC_ACM_CLASS
	help
	  Enumerates with a 500 mA configuration and an inert CDC ACM
	  interface. A host that configures the badge allows the 500 mA SDP
	  input limit; a suspended host puts the charger in HIZ so VBUS
	  carries suspend current (battery present). The D+ pull-up waits for
	  the charger's BC1.2 detection.

config APP_USB_VID
	hex "USB vendor ID"
	default 0x2fe3
	depends on APP_USB_DEVICE
	help
	  0x2FE3 is the Zephyr project's ID for samples and testing, not for
	  products. Kept for this personal, non-distributed badge; set an
	  assigned VID/PID before distributing firmware or boards.

config APP_USB_PID
	hex "USB product ID"
	default 0x0001
	depends on APP_USB_DEVICE

config APP_USB_MANUFACTURER
	string "USB manufacturer string"
	default "Smart LED Badge"
	depends on APP_USB_DEVICE

config APP_USB_PRODUCT
	string "USB product string"
	default "Smart LED Badge Rev A"
	depends on APP_USB_DEVICE

config APP_LOAD_SHED
	bool "Battery load shedding for the matrix"
	default y
	depends on APP_POWER_MANAGER && REVA_MATRIX
	select REVA_MATRIX_POWER_CAP
	help
	  Caps matrix brightness and turns the LED rail off on low battery,
	  with controlled re-enable (power_policy.hpp). The LED rail stays off
	  until the first valid VBAT reading. Thresholds are PROPOSED until
	  pack characterization.

config APP_POWER_STATES
	bool "Charging-only and low-battery off states"
	default y if APP_PROTOTYPE
	depends on APP_POWER_MANAGER
	help
	  Switch OFF with USB present boots a charging-only state (no matrix,
	  microphone, IMU, NFC I2C side or Bluetooth); switch changes restart
	  between states. On battery, a low unloaded VBAT enters System OFF,
	  woken by a USB attach (charger interrupt) or a switch cycle. System
	  OFF needs CONFIG_POWEROFF (set in the Rev A prj.conf; selecting it
	  here forms a Kconfig dependency loop through HWINFO and I2C).

config APP_CHARGING
	bool "Allow battery charging when every gate passes"
	depends on APP_POWER_MANAGER
	help
	  Lets the power manager drive CHG_EN high, at APP_CHARGE_ICHG_MA,
	  only while VBUS is present, the charger reports no fault, TS is
	  normal, the TS thresholds, ICHG and input limit read back as set,
	  VREG is 4200 mV, both VBAT readings agree on a pack in 3.0-4.25 V
	  and a pack-presence probe less than 30 s old passed. Off by default
	  until the charge and thermal tests in validation.md pass.

config APP_CHARGE_ICHG_MA
	int "Charge current (mA)"
	depends on APP_CHARGING
	default 480
	range 80 1000
	help
	  BQ25620 ICHG in 80 mA steps (rounded down). 480 mA for the first
	  charge; the pack allows up to 1.2 A.

config APP_MATRIX_BENCH
	bool "Rev A matrix bench: button-stepped staged LED tests"
	depends on APP_BRINGUP_CHECKS && DISPLAY && REVA_MATRIX_OUTPUT
	select REVA_MATRIX_STALL_TEST
	help
	  Replaces the display demo with staged tests for a current-limited
	  bench supply: rows with zero column current, single LEDs at minimum
	  brightness, row/column walks, patterns, all-on at rising brightness,
	  then the scan-stall test. MODE advances, ACTION stops (blanks) and
	  resumes, or repeats the stall test on its step.

config APP_WATCHDOG_TEST_LOOP
	bool "Bench fault injection: reset until safe mode"
	depends on APP_PROTOTYPE
	help
	  Never enable in normal firmware. Stops the main-loop watchdog feed
	  before a healthy boot; safe mode resumes feeding after three resets.

config APP_NFC
	bool "Persistent NFC URL service"
	default y if APP_PROTOTYPE
	depends on APP_PROTOTYPE && I2C && GPIO

config APP_NFC_FD_LATENCY_US
	int "Field-detect latency margin in microseconds"
	default 500
	range 0 500
	help
	  The prototype value is an unmeasured margin, not a validated latency.
	  Measure field-detect timing before hardware acceptance.
	  This transport supports at most 500 us, reserving status-frame and
	  scheduling headroom within the fixed 5 ms EEPROM deadline. Higher
	  measured latencies require a different transport design, not a longer
	  write timeout. The portable engine rejects unsupported values before I/O.

config APP_NFC_DEBUG_COMMANDS
	bool "Debug-link NFC provisioning and URL commands"
	depends on APP_NFC
	help
	  Explicit development command interface. No irreversible configuration
	  locks are supported. Credentials remain transient and are never logged.

config APP_BLE
	bool "Prototype BLE configuration service"
	depends on APP_PROTOTYPE && APP_NFC && BT && BT_PERIPHERAL
	depends on BT_SMP && BT_SETTINGS && BT_SMP_SC_ONLY && BT_SMP_ENFORCE_MITM
	depends on BT_SMP_APP_PAIRING_ACCEPT
	help
	  Enabled through the matching sysbuild BLE configuration, which also
	  builds the network-core radio. One authenticated client; settings are
	  applied asynchronously and read back before reporting success.

endmenu
```

## firmware/common/src/drivers/dts/bindings/display/smartledbadge,reva-matrix.yaml
```yaml
# SPDX-License-Identifier: MIT
description: Rev A TLC59283 columns and active-low HC595 row chain
compatible: "smartledbadge,reva-matrix"
include: display-controller.yaml
properties:
  spi:
    type: phandle
    required: true
    description: Zephyr SPIM3 bus for the diagnostics chain readback; released before the scan drives its pins
  timer:
    type: phandle
    required: true
    description: Slot TIMER3 sequencing SPI start, LAT and BLANK through PPI; not owned by the Bluetooth controller
  lat-gpios:
    type: phandle-array
    required: true
  blank-gpios:
    type: phandle-array
    required: true
  arm-gpios:
    type: phandle-array
    required: true
  safe-gpios:
    type: phandle-array
    required: true
  enable-gpios:
    type: phandle-array
    required: true
  scan-spim:
    type: phandle
    required: true
    description: SPIM instance driven by PPI for the scan (SPIM2; not owned by a Zephyr driver)
  plane-timer:
    type: phandle
    required: true
    description: Counter TIMER that stops the slot timer after each plane
  sck-gpios:
    type: phandle-array
    required: true
    description: Matrix SCK pin, shared with the readback SPI's pinctrl
  mosi-gpios:
    type: phandle-array
    required: true
    description: Matrix MOSI pin, shared with the readback SPI's pinctrl
```

## firmware/common/src/drivers/dts/bindings/sensor/invensense,icm42688p-i2c.yaml
```yaml
# SPDX-License-Identifier: MIT

description: |
  TDK ICM-42688-P 6-axis IMU on I2C (project driver).

  Property names and value encodings match Zephyr's "invensense,icm4268x"
  binding, so the same node body works if the part moves to SPI. The
  defaults differ (that binding defaults to sensors off), so set every
  property explicitly in board files. Use the macros in
  <zephyr/dt-bindings/sensor/icm42688.h>.

  AP_CS must be held at VDDIO for I2C; AP_AD0 sets the address LSB
  (0x68 or 0x69).

compatible: "invensense,icm42688p-i2c"

include: [sensor-device.yaml, i2c-device.yaml]

properties:
  int-gpios:
    type: phandle-array
    description: |
      INT1. The driver configures it push-pull, active high, pulsed;
      describe it as GPIO_ACTIVE_HIGH.

  accel-pwr-mode:
    type: int
    default: 3
    description: Accelerometer power mode (default low-noise).
    enum: [0, 2, 3]

  accel-odr:
    type: int
    default: 8
    description: Accelerometer output data rate code (default 100 Hz).
    enum: [1, 2, 3, 4, 5, 6, 7, 8, 9, 10, 11, 12, 13, 14, 15]

  accel-fs:
    type: int
    default: 3
    description: Accelerometer full scale code (default +/-2 g).
    enum: [0, 1, 2, 3]

  gyro-pwr-mode:
    type: int
    default: 3
    description: Gyroscope power mode (default low-noise).
    enum: [0, 1, 3]

  gyro-odr:
    type: int
    default: 8
    description: Gyroscope output data rate code (default 100 Hz).
    enum: [1, 2, 3, 4, 5, 6, 7, 8, 9, 10, 11, 15]

  gyro-fs:
    type: int
    default: 0
    description: Gyroscope full scale code (default +/-2000 dps).
    enum: [0, 1, 2, 3, 4, 5, 6, 7]
```

## firmware/common/src/drivers/reva_matrix/Kconfig
```kconfig
# SPDX-License-Identifier: MIT
config REVA_MATRIX
	bool "Rev A TLC59283 / HC595 SPI matrix"
	default y
	depends on DT_HAS_SMARTLEDBADGE_REVA_MATRIX_ENABLED && DISPLAY && SOC_NRF52840
	select GPIO
	select SPI
	select NRFX_GPPI
	help
	  Hardware-driven scan: rows of each brightness plane run from TIMER
	  compares, PPI and SPIM2 EasyDMA without the CPU, and one interrupt
	  per plane sets the next on-time. The slot timer stops in hardware
	  after every plane, so a stalled CPU leaves LAT idle and the external
	  one-shot blanks the matrix. SPIM3 stays with Zephyr's SPI driver for
	  the diagnostics chain readback, before the scan owns the pins.

config REVA_MATRIX_THREAD_PRIORITY
	int "Matrix worker thread priority"
	default 12
	depends on REVA_MATRIX
	help
	  The worker powers the LED rail, starts the scan and supervises plane
	  progress (a scan fault after 500 ms without one); it wakes every
	  100 ms while scanning and never shifts rows itself.

config REVA_MATRIX_OUTPUT
	bool "Allow Rev A LED rail and scanning before board acceptance"
	depends on REVA_MATRIX
	default n
	help
	  Off in the initial bring-up image: LED_EN/ARM remain low and BLANK high.
	  Enable only for current-limited matrix bench bring-up. This is not a
	  substitute for charger, battery, rail and scan-stall acceptance.

config REVA_MATRIX_STALL_TEST
	bool "Scan-stall test for the matrix bench"
	depends on REVA_MATRIX_OUTPUT
	help
	  Adds badge_display_stall_test(): one LED is lit after a single LAT
	  pulse with no further pulses, so the external one-shot must blank it.
	  The driver times MTX_SAFE_SENSE and a timer compare re-blanks through
	  PPI at a hard limit. Matrix bench only.

config REVA_MATRIX_POWER_CAP
	bool "Hold the LED rail off until the power policy sets a ceiling"
	depends on REVA_MATRIX
	help
	  The brightness ceiling starts at 0 (LED rail off) instead of 255 and
	  is raised only by badge_display_set_power_cap() from the battery
	  load-shedding policy.
```

## firmware/rev_a_nrf52840/boards/pixel_badge_reva/Kconfig.pixel_badge_reva
```kconfig
# SPDX-License-Identifier: MIT
config BOARD_PIXEL_BADGE_REVA
	select SOC_NRF52840_QIAA
```

## firmware/rev_a_nrf52840/boards/pixel_badge_reva/board.yml
```yaml
# SPDX-License-Identifier: MIT
board:
  name: pixel_badge_reva
  full_name: Pixel Badge Rev A E73 nRF52840
  vendor: others
  socs:
    - name: nrf52840
```

## firmware/rev_a_nrf52840/boards/pixel_badge_reva/pixel_badge_reva_nrf52840_defconfig
```kconfig
# SPDX-License-Identifier: MIT
CONFIG_ARM_MPU=y
CONFIG_GPIO=y
CONFIG_CLOCK_CONTROL_NRF_K32SRC_XTAL=y
CONFIG_CLOCK_CONTROL_NRF_K32SRC_20PPM=y
```

## firmware/src/drivers/Kconfig
```kconfig
# SPDX-License-Identifier: MIT

menu "Smart LED Badge drivers"

rsource "hub75/Kconfig"
rsource "icm42688_i2c/Kconfig"

endmenu
```

## firmware/src/drivers/dts/bindings/display/smartledbadge,hub75.yaml
```yaml
# SPDX-License-Identifier: MIT

description: |
  HUB75 RGB LED panel driven by GPIO (bench display for the nRF5340 DK).

  Shows a monochrome window of width x height pixels in the top half of a
  1/N-scan panel; the bottom half's data inputs (R2, G2, B2) are tied low.
  Each row slot of the timer shifts the next row while the current row is
  lit. The timer's compare event switches OE off through DPPI and GPIOTE, so
  the on-time does not depend on interrupt latency.

  R1, G1, B1 and CLK must be on one GPIO port.

compatible: "smartledbadge,hub75"

include: display-controller.yaml

properties:
  r1-gpios:
    type: phandle-array
    required: true
  g1-gpios:
    type: phandle-array
    required: true
  b1-gpios:
    type: phandle-array
    required: true
  clk-gpios:
    type: phandle-array
    required: true
  lat-gpios:
    type: phandle-array
    required: true
    description: Latch, pulsed high.
  oe-gpios:
    type: phandle-array
    required: true
    description: Output enable, high = outputs off. Use GPIO_ACTIVE_HIGH.
  addr-gpios:
    type: phandle-array
    required: true
    description: Row address lines, A first.

  panel-columns:
    type: int
    required: true
    description: Pixels shifted per row (the panel's full width).

  timer:
    type: phandle
    required: true
    description: TIMER instance that times the row slots. Keep it disabled.

  row-period-us:
    type: int
    default: 160
    description: Row slot length; refresh = 1 / (rows x period).

  on-color:
    type: int
    default: 7
    description: Colour of a lit pixel, bit 0 red, bit 1 green, bit 2 blue.

  mirror-x:
    type: boolean
    description: Reverse the column order if the image appears mirrored.
```
